## components/esp_board_manager/examples/display_lvgl/sdkconfig.defaults
```kconfig
# SPIRAM
CONFIG_SPIRAM=y
CONFIG_SPIRAM_SPEED_80M=y
CONFIG_SPIRAM_ALLOW_STACK_EXTERNAL_MEMORY=y
CONFIG_SPIRAM_MALLOC_ALWAYSINTERNAL=1024
CONFIG_SPIRAM_TYPE_AUTO=y

#
# Partition Table
#
CONFIG_PARTITION_TABLE_SINGLE_APP=y
CONFIG_PARTITION_TABLE_CUSTOM=y
CONFIG_PARTITION_TABLE_CUSTOM_FILENAME="partitions.csv"
CONFIG_PARTITION_TABLE_FILENAME="partitions.csv"
CONFIG_PARTITION_TABLE_OFFSET=0xA000
CONFIG_PARTITION_TABLE_MD5=y
# end of Partition Table

# LVGL
CONFIG_LV_FONT_MONTSERRAT_14=y
CONFIG_LV_FONT_MONTSERRAT_20=y

# Compiler options
CONFIG_COMPILER_OPTIMIZATION_PERF=y
```

## components/esp_board_manager/test_apps/components/test_amend_features/Kconfig.projbuild
```kconfig
menu "test_amend_features board configuration"

config BMGR_TEST_AMEND_BOARD_KCONFIG
    bool "Board-local feature toggle for amend fixture"
    default n
    help
        Defined by boards/test_amend_features/Kconfig.projbuild. Used to assert
        that the base board's Kconfig.projbuild is appended into the generated
        components/gen_bmgr_codes/Kconfig.projbuild.

endmenu
```

## components/esp_board_manager/test_apps/components/test_amend_features/amend_full/Kconfig.projbuild
```kconfig
menu "test_amend_features amend-top configuration"

config BMGR_TEST_AMEND_TOP_KCONFIG
    bool "Amend-top feature toggle"
    default n

endmenu
```

## components/esp_board_manager/test_apps/components/test_amend_features/amend_full/pack/Kconfig.projbuild
```kconfig
menu "pack amend layer"

config BMGR_TEST_AMEND_PACK_KCONFIG
    bool "Pack-layer Kconfig sentinel"
    default n

endmenu
```

## components/esp_board_manager/test_apps/components/test_amend_features/amend_full/sdkconfig.defaults.board
```kconfig
CONFIG_BMGR_TEST_AMEND_BASE_VALUE=99
CONFIG_BMGR_TEST_AMEND_TOP_ONLY=y
CONFIG_BMGR_TEST_AMEND_BASE_UNSET=y
```

## components/esp_board_manager/test_apps/components/test_amend_features/amend_unreferenced_sdkconfig/sdkconfig.defaults.board
```kconfig
# Intentionally not referenced from board_amend.yaml — must NOT be applied.
CONFIG_BMGR_TEST_AMEND_UNREFERENCED_TRIPWIRE=y
```

## components/esp_board_manager/test_apps/components/test_amend_features/sdkconfig.defaults.board
```kconfig
# Base board comments should be preserved verbatim and ignored by CONFIG override detection
CONFIG_BMGR_TEST_AMEND_BASE_VALUE=1
CONFIG_BMGR_TEST_AMEND_BASE_ONLY=y
# CONFIG_BMGR_TEST_AMEND_BASE_UNSET is not set
```

## sdkconfig.defaults.esp32s31
```kconfig
#
# ESP32-S31 Korvo-1 BT Audio (Classic BT / A2DP Sink) – Full UI
#
# Serial flasher config
CONFIG_ESPTOOLPY_FLASHFREQ_80M=y
CONFIG_ESPTOOLPY_FLASHSIZE_16MB=y

# Partition Table
CONFIG_PARTITION_TABLE_CUSTOM=y
CONFIG_PARTITION_TABLE_CUSTOM_FILENAME="partitions_esp32s31.csv"
CONFIG_PARTITION_TABLE_FILENAME="partitions_esp32s31.csv"
CONFIG_PARTITION_TABLE_OFFSET=0xA000

# PSRAM (required for LVGL / display buffer)
CONFIG_SPIRAM=y
CONFIG_SPIRAM_SPEED_80M=y

# FreeRTOS
CONFIG_FREERTOS_HZ=1000

# Bluetooth Classic via BlueDroid
CONFIG_BT_ENABLED=y
CONFIG_BT_BLUEDROID_ENABLED=y
CONFIG_BT_CONTROLLER_ENABLED=y
CONFIG_BTDM_CTRL_BR_EDR_MAX_SYNC_CONN=1
CONFIG_BT_CLASSIC_ENABLED=y
CONFIG_BT_ENC_KEY_SIZE_CTRL_VSC=y
CONFIG_BT_A2DP_ENABLE=y
CONFIG_BT_A2DP_USE_EXTERNAL_CODEC=y
CONFIG_BT_AVRCP_ENABLED=y
CONFIG_BT_AVRCP_CT_COVER_ART_ENABLED=y
CONFIG_BT_HFP_ENABLE=y
CONFIG_BT_HFP_CLIENT_ENABLE=y
CONFIG_BT_HFP_AG_ENABLE=y
CONFIG_BT_HFP_AUDIO_DATA_PATH_HCI=y
CONFIG_BT_HFP_USE_EXTERNAL_CODEC=y
CONFIG_BTDM_CTRL_MODE_BR_EDR_ONLY=y

# GMF IO support
CONFIG_ESP_BT_AUDIO_GMF_IO_SUPPORT=y

# ── Board Manager: Audio + LCD ──
# NOTE: LCD_TOUCH removed (esp_lcd_touch not available in ESP-IDF v6.2)
CONFIG_ESP_BOARD_PERIPH_ADC_SUPPORT=y
CONFIG_ESP_BOARD_PERIPH_GPIO_SUPPORT=y
CONFIG_ESP_BOARD_PERIPH_I2C_SUPPORT=y
CONFIG_ESP_BOARD_PERIPH_I2S_SUPPORT=y
CONFIG_ESP_BOARD_DEV_AUDIO_CODEC_SUPPORT=y
CONFIG_ESP_BOARD_DEV_DISPLAY_LCD_SUPPORT=y
CONFIG_ESP_BOARD_DEV_DISPLAY_LCD_SUB_RGB_SUPPORT=y

# ── BT UI (LVGL touchscreen) ──
CONFIG_EXAMPLE_BT_UI_ENABLE=y

# ── LVGL v9 ──
CONFIG_LV_CONF_SKIP=y
CONFIG_LV_BUILD_EXAMPLES=n
CONFIG_LV_USE_CLIB_MALLOC=y
CONFIG_LV_USE_CLIB_SPRINTF=y
CONFIG_LV_USE_CLIB_STRING=y
CONFIG_LV_USE_FLOAT=y
CONFIG_LV_USE_GESTURE_RECOGNITION=y
CONFIG_LV_FONT_MONTSERRAT_14=y
CONFIG_LV_FONT_MONTSERRAT_28=y
CONFIG_LV_FONT_MONTSERRAT_32=y
CONFIG_LV_FONT_FMT_TXT_LARGE=y
CONFIG_LV_USE_FONT_PLACEHOLDER=n

# ── I2C backward compatibility ──
CONFIG_CODEC_I2C_BACKWARD_COMPATIBLE=n

# ── Disable unused GMF features (AI audio, video) ──
CONFIG_GMF_LOADER_ENABLE_AI_AUDIO=n
CONFIG_GMF_LOADER_ENABLE_VIDEO_CODEC=n
CONFIG_GMF_LOADER_ENABLE_VIDEO_EFFECTS=n
CONFIG_GMF_APP_UTILS_ENABLE_PERIPHERAL=n
```
